## components/drv_spartan/Kconfig
```kconfig
menu "AFR gauge: Spartan UART"

    choice AFR_SPARTAN_EOL
        prompt "Command line ending"
        default AFR_SPARTAN_EOL_CRLF
        help
            Line ending sent after each Spartan command. The Lite's manual
            does not say which it expects; change this if commands get no
            reply (see Open questions).

        config AFR_SPARTAN_EOL_CRLF
            bool "CR LF"
        config AFR_SPARTAN_EOL_CR
            bool "CR"
        config AFR_SPARTAN_EOL_LF
            bool "LF"
    endchoice

endmenu
```

## main/Kconfig.projbuild
```kconfig
menu "AFR gauge"

    config AFR_SUPPLY_SENSE
        bool "Spartan supply sense fitted on AIN2 (47k/10k divider)"
        default n
        help
            The optional red-wire divider. With it, the gauge also uses the
            Spartan's 12 V to detect power-up (above 9 V) and loss (under
            8 V), and logs supply_v. Without it, AIN2 is not read and
            supply_v is blank.

endmenu
```
